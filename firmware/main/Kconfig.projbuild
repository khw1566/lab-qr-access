## firmware/main/Kconfig.projbuild
```kconfig
menu "Lab Door Config"

    menu "Wi-Fi / Server"
        config LAB_WIFI_SSID
            string "Wi-Fi SSID (실습실 Wi-Fi 이름)"
            default "LAB-WIFI"
        config LAB_WIFI_PASSWORD
            string "Wi-Fi password (개방형이면 비워 두기)"
            default ""
        config LAB_SERVER_URL
            string "Server base URL (끝에 / 없이)"
            default "https://lab.audreaming.com"
        config LAB_DEVICE_API_URL
            string "Device API URL (라즈베리파이 내부망 주소, 비우면 위 Server URL 사용)"
            default ""
            help
                보드가 QR 확인·상태 보고를 보낼 주소. 라즈베리파이 서버를 쓰면 학내망으로 직접 붙도록
                http://<파이IP>:8788 처럼 적는다. Server URL은 학생 안내용 QR 화면에만 쓰인다.
        config LAB_VERIFY_RESPONSE_SIG
            bool "서버 응답 서명 확인 (개방형 Wi-Fi에서 가짜 '열림' 응답 차단)"
            default y
            help
                요청마다 임의 nonce를 보내고, 서버가 단말 키로 만든 X-Lab-Sig 서명이 맞을 때만 응답을 믿는다.
                서명이 없거나 틀리면 서버 연결 실패로 처리해 문을 열지 않는다.
        config LAB_DEVICE_KEY
            string "Device key (관리자 화면 > 단말 등록에서 발급)"
            default ""
        config LAB_ADMIN_PIN
            string "단말 설정 화면 비밀번호 (저장소에 올리지 말고 sdkconfig에만 둘 것)"
            default ""
    endmenu

    menu "Weather (상단 바 날씨)"
        config LAB_WEATHER_ENABLE
            bool "상단 바에 현재 날씨 표시 (Open-Meteo, API 키 없음)"
            default y
            help
                보드가 api.open-meteo.com 에서 현재 기온과 날씨 코드를 받아 상단 바에 보여 준다.
                출입 검증과는 관계없어서 날씨를 못 받아도 출입 기능은 그대로 동작한다.
        config LAB_WEATHER_LAT
            string "위도 (실습실 위치)"
            depends on LAB_WEATHER_ENABLE
            default "35.5384"
        config LAB_WEATHER_LON
            string "경도 (실습실 위치)"
            depends on LAB_WEATHER_ENABLE
            default "129.3114"
        config LAB_WEATHER_REFRESH_MIN
            int "날씨 갱신 주기 (분)"
            depends on LAB_WEATHER_ENABLE
            range 5 180
            default 15
    endmenu

    menu "Board pins (JC1060P470C)"
        config LAB_I2C_SDA
            int "Shared I2C SDA (touch / camera / 4P I2C)"
            default 7
        config LAB_I2C_SCL
            int "Shared I2C SCL"
            default 8
        config LAB_CAM_RESET_GPIO
            int "Camera reset GPIO (-1 = none)"
            default -1
        config LAB_CAM_PWDN_GPIO
            int "Camera power-down GPIO (-1 = none)"
            default -1
        config LAB_LCD_RESET_GPIO
            int "LCD reset GPIO"
            default 0
        config LAB_LCD_BACKLIGHT_GPIO
            int "LCD backlight GPIO"
            default 23
        config LAB_AUDIO_MCLK_GPIO
            int "ES8311 I2S MCLK GPIO"
            default 13
        config LAB_AUDIO_BCLK_GPIO
            int "ES8311 I2S BCLK GPIO"
            default 12
        config LAB_AUDIO_WS_GPIO
            int "ES8311 I2S LRCK GPIO"
            default 10
        config LAB_AUDIO_DOUT_GPIO
            int "ES8311 I2S speaker data GPIO"
            default 9
        config LAB_AUDIO_AMP_GPIO
            int "Speaker amplifier enable GPIO"
            default 11
        config LAB_AUDIO_DIN_GPIO
            int "ES8311 I2S mic data GPIO (ASDOUT, -1 = 마이크 안 씀)"
            default 48
            help
                ES8311의 마이크 ADC 출력(ASDOUT)이 연결된 P4 핀. 보드 회로도로 확인하지 못한 값이라
                실시간 보기에서 소리가 안 들리면 회로도를 보고 바꾸거나 -1로 꺼 두세요.
    endmenu

    menu "Live view (관리자 실시간 보기)"
        config LAB_LIVE_ENABLE
            bool "관리자 실시간 보기 (카메라 영상, 소리 듣기, 말하기)"
            default y
            help
                관리자가 웹에서 실시간 보기를 열면 보드가 서버 중계에 wss로 붙어 카메라 영상을 보내고
                관리자의 말을 스피커로 재생한다. 소리 듣기는 서버 기능 설정에서 허용한 경우만 동작한다.
                영상과 음성은 보드에도 서버에도 저장하지 않는다.
        config LAB_LIVE_JPEG_QUALITY
            int "JPEG 품질 (1~100, 낮을수록 데이터가 적음)"
            depends on LAB_LIVE_ENABLE
            range 1 100
            default 50
    endmenu

    menu "Door relay"
        config LAB_RELAY_GPIO
            int "Relay control GPIO (기본 GPIO27, 5V 1채널 옵토 릴레이 IN)"
            default 27
        config LAB_RELAY_GPIO2
            int "추가 릴레이 GPIO 2 (같은 신호로 함께 켬, -1 = 사용 안 함)"
            default 26
        config LAB_RELAY_GPIO3
            int "추가 릴레이 GPIO 3 (같은 신호로 함께 켬, -1 = 사용 안 함)"
            default 25
            help
                ESP32-P4의 GPIO24/25는 USB Serial/JTAG(D-/D+)로도 쓰인다. 보드의 USB 포트(COM22)가 이 핀에
                연결되어 있으면 GPIO25를 출력으로 쓰는 순간 USB 시리얼이 끊긴다. 그때는 -1로 바꾸고,
                굽기는 BOOT 버튼을 누른 채 리셋해 다운로드 모드로 들어가서 한다.
        config LAB_RELAY_ACTIVE_HIGH
            bool "Relay is active-high"
            default y
        config LAB_DOOR_MIN_OPEN_MS
            int "최소 문 열림 신호 시간 (ms, 서버 설정이 더 짧아도 이만큼 유지)"
            default 5000

        config LAB_DOOR_MAX_OPEN_MS
            int "Max door open pulse (ms)"
            default 10000
        config LAB_BUZZER_GPIO
            int "Status buzzer/LED GPIO (-1 = 사용 안 함)"
            default -1
    endmenu
endmenu
```
